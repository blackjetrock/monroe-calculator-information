//////////////////////////////////////////////////////////////////////////////
//
// Monroe 2890 Cartridge Emulator
//
////////////////////////////////////////////////////////////////////////////////
//
// Emulates memory
//
//
//
//
////////////////////////////////////////////////////////////////////////////////

#include "switches.h"
#include "version.h"

#pragma GCC diagnostic ignored "-Wwrite-strings"

#include <ctype.h>
#include <math.h>
#include <stdarg.h>
#include <stdio.h>
#include <stdlib.h>
#include <string.h>
#include <stdint.h>

#include "pico/stdlib.h"
#include "hardware/pio.h"
#include "hardware/dma.h"
#include "hardware/irq.h"
#include "hardware/flash.h"
#include "hardware/clocks.h"
#include "hardware/structs/bus_ctrl.h"

#define DEBUG_STOP_LOOP while(1) {}

// Some logic to analyse:

#include "hardware/structs/pwm.h"
#include "pico/multicore.h"
#include "pico/bootrom.h"

#include "oled.h"
#include "sdcard.h"

#include "menu.h"

////////////////////////////////////////////////////////////////////////////////

#define MAX_FILE_LINE 200

////////////////////////////////////////////////////////////////////////////////
//
#define ACORN_PORTD   0x2E21

////////////////////////////////////////////////////////////////////////////////
//
// VDU registers
#define NUM_VDU_REGS 20

volatile uint8_t vdu_reg[NUM_VDU_REGS];
volatile uint8_t vdu_addr = 0xcc;

#define VDU_REG_HOR_DISP  1
#define VDU_REG_VER_DISP  6

#define VDU_REG_STARTH   12
#define VDU_REG_STARTL   13
#define VDU_REG_CURSRH   14
#define VDU_REG_CURSRL   15

#define VDU_START_ADDRESS (vdu_reg[VDU_REG_STARTH]*256+vdu_reg[VDU_REG_STARTL])
#define VDU_CURSR_ADDRESS (vdu_reg[VDU_REG_CURSRH]*256+vdu_reg[VDU_REG_CURSRL])
#define VDU_NUM_CHARS     (vdu_reg[VDU_REG_HOR_DISP]*vdu_reg[VDU_REG_VER_DISP])

////////////////////////////////////////////////////////////////////////////////
//
// Tracing of processor accesses
//

#define TRACE_ON 1

// How many addresses are traced
#define TRACE_N   32

volatile int trace_i = 0;
volatile int trace_running = 0;

volatile uint16_t trace_addr[TRACE_N];
volatile uint8_t trace_value[TRACE_N];
volatile char trace_type[TRACE_N];

////////////////////////////////////////////////////////////////////////////////

void prompt(void);
void serial_help(void);

////////////////////////////////////////////////////////////////////////////////

// How much RAM to display 
#define RAM_SIZE 1024

// Shadow of entire memory space
#define MEM_SIZE 65536

volatile uint8_t mem_data[MEM_SIZE];

#define ADDRESS_MASK  0x07FF
#define WINDOW_START  0x8000

////////////////////////////////////////////////////////////////////////////////
//
// 


#define MASK_CEOE0    (1 << PIN_CEOE0)
#define MASK_CEOE1    (1 << PIN_CEOE1)
#define MASK_CEOE2    (1 << PIN_CEOE2)
#define MASK_CEOE3    (1 << PIN_CEOE3)

#define VAL_CEOE0_LOW (MASK_CEOE1 | MASK_CEOE2 | MASK_CEOE3)
#define VAL_CEOE1_LOW (MASK_CEOE0 | MASK_CEOE2 | MASK_CEOE3)
#define VAL_CEOE2_LOW (MASK_CEOE0 | MASK_CEOE1 | MASK_CEOE3)
#define VAL_CEOE3_LOW (MASK_CEOE0 | MASK_CEOE1 | MASK_CEOE2)

#define MASK_ALL_CEOE (MASK_CEOE0 | MASK_CEOE1 | MASK_CEOE2 | MASK_CEOE3 )
#define ANY_CEOE_LOW  ( (gpio_states & MASK_ALL_CEOE) != MASK_ALL_CEOE)

////////////////////////////////////////////////////////////////////////////////

// Value that can be set from the keyboard
// Can be entered as hex or decimal

#define PAR_TYPE_DEC 0

int parameter = 0;
int keypress = 0;

#define TEXT_PARAMETER_LEN 40
char text_parameter[TEXT_PARAMETER_LEN+1] = "";

////////////////////////////////////////////////////////////////////////////////
//
// GPIOs
//

const int PIN_D0        =  0;
const int PIN_D1        =  1;
const int PIN_D2        =  2;
const int PIN_D3        =  3;
const int PIN_D4        =  4;
const int PIN_D5        =  5;
const int PIN_D6        =  6;
const int PIN_D7        =  7;

const int PIN_CEOE0     =  8;
const int PIN_CEOE1     =  9;
const int PIN_CEOE2     =  10;
const int PIN_CEOE3     =  11;

const int PIN_NRDS      =  12;
const int PIN_SYNC      =  13;
const int PIN_PHI2      =  14;
const int PIN_RW        =  15;

#define PIN_BITNUM_NWDS    11
#define PIN_BITNUM_NRDS    12

// SD card GPIOs here
const int PIN_K3        =  27;
const int PIN_K2        =  28;
const int PIN_K1        =  29;


const int PIN_A0        =  32;
const int PIN_A1        =  33; 
const int PIN_A2        =  34; 
const int PIN_A3        =  35; 
const int PIN_A4        =  36; 
const int PIN_A5        =  37; 
const int PIN_A6        =  38; 
const int PIN_A7        =  39; 
const int PIN_A8        =  40; 
const int PIN_A9        =  41; 
const int PIN_A10       =  42; 
const int PIN_A11       =  43; 
const int PIN_A12       =  44; 
const int PIN_A13       =  45; 
const int PIN_A14       =  46; 
const int PIN_A15       =  47; 


////////////////////////////////////////////////////////////////////////////////
//
// Chris oddy display
//

uint8_t app1[] =
  {
    0xa2, 0x07, 0xbd, 0x10, 0x80, 0x95, 0x10, 0xca, 0x10, 0xf8, 0x20, 0x0c, 0xfe, 0x4c, 0xfb, 0xfe,
    0x00, 0x77, 0x58, 0x5c, 0x50, 0x54, 0x00, 0x30,
  };


//------------------------------------------------------------------------------

uint8_t *app_list[] =
  {
    app1,
  };

////////////////////////////////////////////////////////////////////////////////

void set_gpio_output(const int gpio)
{
  gpio_init(gpio);
  gpio_set_dir(gpio, GPIO_OUT);
}

void set_gpio_input(const int gpio)
{
  gpio_init(gpio);
  gpio_set_dir(gpio, GPIO_IN);
}

////////////////////////////////////////////////////////////////////////////////

////////////////////////////////////////////////////////////////////////////////

void run_mount(void) {
  //    const char *arg = chk_dflt_log_drv(argc, argv);
  const char *arg = "0:";
  if (!arg)
        return;
    sd_card_t *sd_card_p = sd_get_by_drive_prefix(arg);
    if (!sd_card_p) {
        printf("Unknown logical drive id: \"%s\"\n", arg);
        return;
    }
    FATFS *fs_p = &sd_card_p->state.fatfs;
    FRESULT fr = f_mount(fs_p, arg, 1);
    if (FR_OK != fr) {
        printf("f_mount error: %s (%d)\n", FRESULT_str(fr), fr);
        return;
    }
    sd_card_p->state.mounted = true;
}

void run_unmount(void) {
  //    const char *arg = chk_dflt_log_drv(argc, argv);
  const char *arg = "0:";
  
  if (!arg)
        return;

    sd_card_t *sd_card_p = sd_get_by_drive_prefix(arg);
    if (!sd_card_p) {
        printf("Unknown logical drive id: \"%s\"\n", arg);
        return;
    }    
    FRESULT fr = f_unmount(arg);
    if (FR_OK != fr) {
        printf("f_unmount error: %s (%d)\n", FRESULT_str(fr), fr);
        return;
    }
    sd_card_p->state.mounted = false;
    sd_card_p->state.m_Status |= STA_NOINIT;  // in case medium is removed
}

////////////////////////////////////////////////////////////////////////////////

void display_ram_at(uint8_t *dat)
{
  printf("\n");
  
  for(int z = 0; z<RAM_SIZE; z++)
    {
      int byte = 0;
      
      if( (z % 8) == 0)
	{
	  printf("\n%03X: ", z);
	}
      
      printf("%02X ", *(dat++));
    }
  
  printf("\n");

}

////////////////////////////////////////////////////////////////////////////////
//
// Flash data
//
// We have several flash program slots.
// Slots are in the top 1Mbyte of flash
//
// The flash has to be erased in 4096 byte aligned blocks
// Writes can be 256 byte aligned but due to erase being 4096 we use that slot size.

// Program and dat aram is stored at the same time, so it is a snapshot of the entire
// RAM. RAM plkus program is 256 bytes.


#define FLASH_PROGRAM_DATA_SIZE         256
#define FLASH_PROGRAM_SLOT_SIZE         4096
#define FLASH_PROGRAM_SLOT_AREA_SIZE    (1000*1024)
#define FLASH_PROGRAM_NUM_SLOTS         (FLASH_PROGRAM_SLOT_AREA_SIZE / FLASH_PROGRAM_SLOT_SIZE)

#define FLASH_SLOT_OFFSET (1024*1024)
uint8_t *flash_slot_contents   = (uint8_t *) (XIP_BASE + FLASH_SLOT_OFFSET);

// general buffer for flash read and write
uint8_t slot_buffer[FLASH_PROGRAM_DATA_SIZE];


////////////////////////////////////////////////////////////////////////////////
//
// Flash write/erase
//
////////////////////////////////////////////////////////////////////////////////

// Erase a slot
void erase_slot(int n)
{
  flash_range_erase(FLASH_SLOT_OFFSET+n*FLASH_PROGRAM_SLOT_SIZE, FLASH_PROGRAM_SLOT_SIZE);
}

// Checksum a slot
int checksum_slot(int slot_num)
{
  int csum = 0;

  for(int i=0; i<FLASH_PROGRAM_DATA_SIZE; i++)
    {
      csum += *(flash_slot_contents+slot_num*FLASH_PROGRAM_SLOT_SIZE+i);
    }

  return(csum);
}
void cli_erase_program_slot(void)
{
  printf("\nErasing program slot %d...", parameter);
  erase_slot(parameter);
  printf("\ndone.\n");
}

void cli_display_program_slot(void)
{
  
  printf("\nSlot %d\n", parameter);

  // First dump in hex
  display_ram_at(flash_slot_contents+parameter*FLASH_PROGRAM_SLOT_SIZE);

  printf("\n\n");
}

void cli_display_vdu_regs(void)
{
  printf("\nVDU Regs\n");

  printf("\nVDU_START:     %04X", VDU_START_ADDRESS);
  printf("\nVDU_NUM_CHARS: %04X (%d)", VDU_NUM_CHARS, VDU_NUM_CHARS);
  
  printf("\nAddr:%02X", vdu_addr);

  for(int i=0; i<NUM_VDU_REGS; i++)
    {
      printf("\n%02X:%02X", i, vdu_reg[i]);
    }

  printf("\n");
}


////////////////////////////////////////////////////////////////////////////////


void cli_get_vdu(void)
{
  // Display the VDU screen area
  //

  printf("\n/--------------------------------------------------------------------------------\\");
  
  for(int i=0; i< 2000; i++)
    {
      if( (i % 80) == 0 )
        {
          if( i != 0 )
            {
              printf("|");
            }
          
          printf("\n|");
        }
      
      printf("%c", mem_data[0x1000+i]);
    }

  printf("|\n\\--------------------------------------------------------------------------------/");
  printf("\n");
}
////////////////////////////////////////////////////////////////////////////////

uint8_t screen[8192];

int cursor_on = 1;
int cursor_counter = 0;

void update_screen(void)
{
  // Cursor Position (Row, Col): ESC [ <row>;<col> H (e.g., 10,10)
  // Save Cursor Position: ESC 7 (DECSC)
  // Restore Cursor Position: ESC 8 (DECRC)

  cursor_counter++;

  if( cursor_counter > 12 )
    {
      cursor_on = !cursor_on;
      cursor_counter = 0;
    }
  
  // Compare screen buffer with memory, update any changes
  int x = 0;
  int y = 0;

  int vdu_start = VDU_START_ADDRESS;
  int vdu_addr = (vdu_start & 0x07FF) | 0x1000;
  int cur_addr = (VDU_CURSR_ADDRESS & 0x07FF) | 0x1000;
  
  printf("%c7", 27);
  printf("%c[?25l", 27);
  
  for(int i=0; i< 2000; i++)
    {
      if( mem_data[vdu_addr] != screen[i],1 )
        {

          printf("%c[%d;%dH", 27, y+2, x+2);
          if( cur_addr == vdu_addr )
            {
              if( cursor_on )
                {
                  printf("%c", '_');
                }
              else
                {
                  printf("%c", mem_data[vdu_addr]);
                }
            }
          else
            {
              printf("%c", mem_data[vdu_addr]);
            }
          
          //screen[i] = mem_data[vdu_addr];
        }

      vdu_addr = ((vdu_addr+1) & 0x07ff) | 0X1000;

      x++;
      
      if( x >= 80 )
        {
          x = 0;
          y++;
        }
    }
  
  printf("%c8", 27);
  printf("%c[?25h", 27);
}

//------------------------------------------------------------------------------

void cli_vdu_loop(void)
{
  int done = 0;
  int  key;
  
  printf("\nVDU Loop...\n");

  for(int i=0; i<200; i++)
    {
      printf("\n");
    }
  
  // Inital screen display
  
  cli_get_vdu();
  
  while(!done)
    {
      update_screen();
      
      if( ((key = getchar_timeout_us(1000)) != PICO_ERROR_TIMEOUT))
        {
          switch(key)
            {
            case '_':
              cli_get_vdu();
              break;
              
            case 27:
              done = 1;            
              printf("\nExit from VDU Loop\n");
              break;

            default:
              // Send to Acorn
              mem_data[ACORN_PORTD] = key | 0x80;
              sleep_us(100);
              mem_data[ACORN_PORTD] = key;
              break;
            }
	}
    }
}

////////////////////////////////////////////////////////////////////////////////
//
// Load app, index is parameter
//

void cli_load_app(void)
{
  uint8_t *app_ptr;
  int num_apps = (sizeof(app_list) / sizeof(uint8_t *));
  
  printf("\n%d apps", num_apps);
  
  if( (parameter >= 0) && (parameter < num_apps) )
    {
      app_ptr = app_list[parameter];
      
      memcpy((void *)&(mem_data[0x8000]), (void *)app_list[parameter], sizeof(app1));

      printf("\nLoaded app %d", parameter);
    }
  else
    {
      printf("\nParameter out of range");
    }
  

}

////////////////////////////////////////////////////////////////////////////////

void cli_boot_mass(void)
{
  reset_usb_boot(0,0);
}

void cli_do_reset(void)
{
  
}
////////////////////////////////////////////////////////////////////////////////
//
// Scans the directory and works out the next file number to use
//
// Leaves max_filenum with that value
//
////////////////////////////////////////////////////////////////////////////////

#define FILE_NAME_FORMAT "as1%04d.bin"
#define INFO_FILE_NAME_FORMAT "as1%04d.inf"

#define FILE_NAME_SCAN   "as1%d.bin"
#define FILE_NAME_GLOB   "as1*.bin"

int find_next_file_number(void)
{
  int file_n = 0;
  int num_listfiles = 0;
  int i;
  
  char cwdbuf[FF_LFN_BUF] = {0};
  FRESULT fr;
  char const *p_dir;

  //DEBUG_STOP;

  printf("\nAttempting to cd to directory...");
  if( !cd_to_dir(FILES_DIR) )
    {
      unmount_sd();
      return(0);
    }

  printf("\nGetting cwd...");
  fr = f_getcwd(cwdbuf, sizeof cwdbuf);

  // printf will print to console
  if (FR_OK != fr)
    {
      printf("f_getcwd error: %s (%d)\n", FRESULT_str(fr), fr);
      return(0);
    }
  
  p_dir = cwdbuf;

  printf("\nFile num search: %s\n", p_dir);
  
  DIR dj;      /* Directory object */
  FILINFO fno; /* File information */

  memset(&dj, 0, sizeof dj);
  memset(&fno, 0, sizeof fno);

  max_filenum = 0;
  
  fr = f_findfirst(&dj, &fno, p_dir, FILE_NAME_GLOB);

  if (FR_OK != fr)
    {
      printf("f_findfirst error: %s (%d)\n", FRESULT_str(fr), fr);
      return(0);
    }
  
  while( (fr == FR_OK) && fno.fname[0])
    { 
      if (fno.fattrib & AM_DIR)
	{
	  // Directory, we ignore these
	}
      else
	{
	  int filenum;
	  sscanf(fno.fname, FILE_NAME_SCAN, &filenum);

	  if( filenum > max_filenum )
	    {
	      max_filenum = filenum;
	    }
	}
       
      fr = f_findnext(&dj, &fno); /* Search for next item */
    }
  
  f_closedir(&dj);

  printf("\nFound next file number %d", max_filenum);
  return(1);
}

////////////////////////////////////////////////////////////////////////////////
//
// Writes the buffer to a file.
// Deletes any file that exists with the same name so that the resulting
// file is the same size as the buffer
// Searches the card directory for the highest file number and uses the next one
//
////////////////////////////////////////////////////////////////////////////////

void core_writefile(int address, int length)
{
  char filename[20];
  char info_filename[20];
  int i;
  FRESULT fr;
  FIL fp;
  size_t bytes_written = 0;
  char line[40];

  //DEBUG_STOP

  printf("\nWriting file to SD card");
  mount_sd();

  if( !cd_to_dir(FILES_DIR) )
    {
      unmount_sd();
      return;
    }

  find_next_file_number();
  sprintf(filename,      FILE_NAME_FORMAT,      ++max_filenum);
  sprintf(info_filename, INFO_FILE_NAME_FORMAT,   max_filenum);

  printf("\nWriting to %s", filename);
  
  oled_clear_display(&oled0);
  oled_set_xy(&oled0, 0, 0);
  oled_display_string(&oled0, "Writing");
  oled_set_xy(&oled0, 0, 8);
  oled_display_string(&oled0, filename);
  
  // Open file for writing
  fr = f_open(&fp, filename, FA_CREATE_NEW | FA_WRITE);

  if (FR_OK != fr && FR_EXIST != fr)
    {
      printf("\nOpen error");
      //      oled_error("Open error");
      unmount_sd();
      return;
    }

  printf("\nWriting data...");

  // Split up into smaller chunks
  int length_to_go = length;
  int addr = address;

#define CHUNK_SIZE 32
  
  while( length_to_go > 0 )
    {
      if( length_to_go > CHUNK_SIZE )
        {
          printf("\nWriting %d bytes at %04X", CHUNK_SIZE, addr);
          f_write (&fp, (uint8_t *)&(mem_data[addr]), CHUNK_SIZE, &bytes_written);
          length_to_go -= CHUNK_SIZE;
          addr += CHUNK_SIZE;
          printf(" %ld bytes written");
        }
      else
        {
          printf("\nWriting %d bytes at %04X", length_to_go, addr);
          f_write (&fp, (uint8_t *)&(mem_data[addr]), length_to_go, &bytes_written);
          length_to_go = 0;
          addr += length_to_go;
          printf(" %ld bytes written");
        }
    }
  
  
  fr = f_close(&fp);
  if (FR_OK != fr)
    {
      printf("f_close error: %s (%d)\n", FRESULT_str(fr), fr);
      unmount_sd();
      return;
    }

  //------------------------------------------------------------------------------
  //
  // Now write an info file to go with the data
  // Open file for writing
  fr = f_open(&fp, info_filename, FA_CREATE_NEW | FA_WRITE);

  if (FR_OK != fr && FR_EXIST != fr)
    {
      printf("\nOpen error");
      //      oled_error("Open error");
      unmount_sd();
      return;
    }

  printf("\nWriting data...");

  // Write the entire buffer in one go
  f_printf(&fp, "\n*ADDRESS:0000");
  f_printf(&fp, "\n*LENGTH:%04X", MEM_SIZE);
  
  fr = f_close(&fp);
  if (FR_OK != fr)
    {
      printf("f_close error: %s (%d)\n", FRESULT_str(fr), fr);
      unmount_sd();
      return;
    }

  oled_set_xy(&oled0, 0, 3*8);
  sprintf(line, "%d bytes", bytes_written);
  oled_display_string(&oled0, line);

  unmount_sd();

  printf("\nDone.\n");
}
//------------------------------------------------------------------------------
//
// Save all of memory to SD card
//

void cli_snapshot_memory(void)
{
  core_writefile(0x0000, MEM_SIZE);
}

//------------------------------------------------------------------------------

void cli_ls(void)
{
  printf("\nSD Card Listing:\n");
  run_mount();

  ls(FILES_DIR);
  run_unmount();
}

//------------------------------------------------------------------------------

void cli_dump_window(void)
{
  for(int a=WINDOW_START; a<(WINDOW_START+256); a++)
    {
      if( (a % 64) == 0 )
        {
          printf("\n%04X: ", a);
        }

      printf(" %02X", mem_data[a]);
    }

  printf("\n");
  
}


////////////////////////////////////////////////////////////////////////////////

#define BYTE_WIDTH 16

void cli_dump_ram(void)
{
  char ascii[BYTE_WIDTH*3+5];
  char ascii_byte[5];

  // Bound the address to 64K

  parameter %= 64*1024;
  
  // Display memory from address
  printf("\n");

  ascii[0] = '\0';
  
  for(unsigned int z = parameter; z<parameter+512; z++)
    {
      int byte = 0;
      
      if( (z % BYTE_WIDTH) == 0)
	{
	  printf("  %s", ascii);
	  ascii[0] = '\0';
	  printf("\n%08X: ", z);
	}

      byte = mem_data[z];

      printf(" %02X", byte);
      
      if( isprint(byte) )
	{
	  sprintf(ascii_byte, "%c", byte);
	}
      else
	{
	  sprintf(ascii_byte, ".");
	}
      
      strcat(ascii, ascii_byte);
    }
  
  printf("\n");

  parameter += 512;
}

//------------------------------------------------------------------------------

void cli_dump_ram2(void)
{
  for(int a=parameter; a<parameter+256; a++)
    {
      if( (a % 16) == 0 )
        {
          printf("\n%04X: ", a);
        }
      else
        {
          if( (a % 8) == 0 )
            {
              printf(" ");
            }
        }
      
      printf(" %02X", mem_data[a]);
    }

  printf("\n");
  
}

////////////////////////////////////////////////////////////////////////////////

void prompt(void)
{
  printf("\n\n(Text Parameter:'%s'", text_parameter);
#if PAR_TYPE_DEC
  printf("\n(Parameter %d >", parameter);
#else
  printf("\n(Parameter 0x%04X >", parameter);
#endif
}


////////////////////////////////////////////////////////////////////////////////
//
//
// We allow digits to enter a new value for the parameter

void cli_enter_parameter()
{
  int  key;
  int done = 0;

  printf("\nEnter parameter: (ESC or <RETURN> to exit)");
  
  parameter = 0;
  
  while(!done)
    {
      if( ((key = getchar_timeout_us(1000)) != PICO_ERROR_TIMEOUT))
	{
#if PAR_TYPE_DEC
	  switch(key)
	    {
	    case '0':
	    case '1':
	    case '2':
	    case '3':
	    case '4':
	    case '5':
	    case '6':
	    case '7':
	    case '8':
	    case '9':
	      parameter *= 10;
	      parameter += (key - '0');
	      prompt();
	      break;

	    case 27:
	    case 13:
	    case 10:
	      done = 1;
	      break;
	      
	    default:
	      break;
	    }
#else
	  switch(key)
	    {
	    case '0':
	    case '1':
	    case '2':
	    case '3':
	    case '4':
	    case '5':
	    case '6':
	    case '7':
	    case '8':
	    case '9':
	      parameter *= 16;
	      parameter += (key - '0');
	      prompt();
	      break;
              
	    case 'a':
	    case 'b':
	    case 'c':
	    case 'd':
	    case 'e':
	    case 'f':
	      parameter *= 16;
	      parameter += (key - 'a'+10);
	      prompt();
              break;
              
	    case 27:
	    case 13:
	    case 10:
	      done = 1;
	      break;
	      
	    default:
	      break;
	    }
#endif
	}
      else
	{
	  // I have found that I need to send something if the serial USB times out
	  // otherwise I get lockups on the serial communications.
	  // So, if we get a timeout we send a space and backspace it. And
	  // flush the stdio, but that didn't fix the problem but seems like a good idea.
	  stdio_flush();
	  //printf(" \b");
	}
    }
}

////////////////////////////////////////////////////////////////////////////////
//
// Reads and prints a file
//

int cat_file(char *fn)
{
  char line[MAX_FILE_LINE];
  char fileline[MAX_FILE_LINE];

  mount_sd();
  
  if( !cd_to_dir(FILES_DIR) )
    {
      unmount_sd();
      return(0);
    }
  
  sprintf("Reading '%s'", fn);

  FF_FILE *fp = ff_fopen(fn, "r");

  if (fp == NULL)
    {
      printf("Failed to open:%s", fn);
      unmount_sd();
      return(0);
    }
  
  // Get lines from the file
  while( ff_fgets(&(fileline[0]), sizeof(fileline)-1, fp) != NULL )
    {
      printf("%s", fileline);
    }
  
  ff_fclose(fp);
  unmount_sd();
  return(1);
}

////////////////////////////////////////////////////////////////////////////////
//
// Reads a binary file into emulation memory at the address given
//

int read_binary_file(char *fn, int address)
{
  char line[MAX_FILE_LINE];
  char fileline[MAX_FILE_LINE];
  volatile uint8_t *ptr = &(mem_data[address]);

  printf("\nLoading %s", fn);
  
  mount_sd();
  
  if( !cd_to_dir(FILES_DIR) )
    {
      unmount_sd();
      return(0);
    }
  
  sprintf("Reading '%s'", fn);

  FF_FILE *fp = ff_fopen(fn, "r");

  if (fp == NULL)
    {
      printf("Failed to open:%s", fn);
      unmount_sd();
      return(0);
    }

  while(1)
    {
      // Read binary file data
      int ni = ff_fread((void *)ptr, 1, 1, fp);

      if( f_eof(fp) || (ni == 0))
        {
          // No more file
          ff_fclose(fp);
          unmount_sd();
          return(0);
        }

      ptr++;
    }
  
  ff_fclose(fp);
  unmount_sd();
  return(1);
}

////////////////////////////////////////////////////////////////////////////////
//
// trace what the processor is doing

void cli_trace_addresses(void)
{
  trace_i = 0;
  trace_running = 1;
}

void cli_dump_trace(void)
{
  printf("\nTrace\n");
  printf("\nTrace index;%d Trace running:%d\n", trace_i, trace_running);
  
  for(int i = 0; i< TRACE_N; i++)
    {
      printf("\n%02X: %04X %c %02X", i, trace_addr[i], trace_type[i], trace_value[i]);
    }
  printf("\n");
}

//------------------------------------------------------------------------------

void cli_read_file(void)
{
  read_binary_file("retrofest26.bin", 0x8000);
}

void cli_load_monitor(void)
{
  read_binary_file("monitor.bin", 0xFE00);
}

void cli_load_basic(void)
{
  read_binary_file("System BASIC.bin", 0xC000);
}

void cli_load_cos40(void)
{
  read_binary_file("COS40.bin", 0xF800);
}


void cli_version(void)
{
  printf("\nVersion:1.1.%d Compile time:%s %s\n", VERSION_INC, __DATE__, __TIME__);
}

void cli_digit(void)
{
  printf("\n%d", keypress);
}

void cli_information(void)
{
  // Set up OLED display
  i2c_init(&i2c_bus_0);
  
  oled_setup(&oled0);

  // Overall loop, which contains the polling loop and the menu loop
  oled_clear_display(&oled0);
  
  oled_set_xy(&oled0, 0, 0);
  oled_display_string(&oled0, "Acorn System 1");

  oled_set_xy(&oled0, 0, 8);
  oled_display_string(&oled0, "Memory Emulator");

  // Sets sd_ok flag for later use
  printf("\nInitialising SD card driver...");

#define SD_CARD 1

  // Initialise SD card driver
  sd_init_driver();

  // Mount and unmount the SD card to set the sd_ok_flag up
  mount_sd();
  unmount_sd();
  
  oled_set_xy(&oled0, 0,21);
  if( sd_ok_flag )
    {
      oled_set_xy(&oled0, 0, 16);
      oled_display_string(&oled0, "SD card OK");
      printf("\nSD card OK");
    }
  else
    {
      oled_set_xy(&oled0, 0, 16);
      oled_display_string(&oled0, "SD card NOT OK");
      printf("\nSD card NOT OK");
    }

}


////////////////////////////////////////////////////////////////////////////////
////////////////////////////////////////////////////////////////////////////////

// Serial loop command structure

typedef void (*SERIAL_FPTR)(void);

typedef struct
{
  char key;
  char *desc;
  SERIAL_FPTR fn;
} SERIAL_COMMAND;

SERIAL_COMMAND serial_cmds[] =
  {
    {
      '?',
      "Serial command help",
      serial_help,
    },
    {
      '!',
      "Boot to mass storage",
      cli_boot_mass,
    },
    {
      'i',
      "Information",
      cli_information,
    },
    {
      'L',
      "Load binary file",
      cli_read_file,
    },
    {
      'v',
      "Get VDU data",
      cli_get_vdu,
    },
    {
      'V',
      "VDU Loop",
      cli_vdu_loop,
    },
    {
      'S',
      "Save binary file",
      cli_read_file,
    },
    {
      'T',
      "Snapshot emulated memory",
      cli_snapshot_memory,
    },
    {
      'M',
      "Load monitor",
      cli_load_monitor,
    },
    {
      'B',
      "Load BASIC",
      cli_load_basic,
    },
    {
      'C',
      "Load COS40",
      cli_load_cos40,
    },
    {
      't',
      "Trace",
      cli_trace_addresses,
    },
    {
      'u',
      "Dump trace",
      cli_dump_trace,
    },
    {
      'l',
      "List Files",
      cli_ls,
    },
    {
      'a',
      "Dump RAM",
      cli_dump_ram,
    },
    {
      'w',
      "Dump memory window",
      cli_dump_window,
    },
    {
      'z',
      "Enter parameter value",
      cli_enter_parameter,
    },
    {
      'v',
      "Version",
      cli_version,
    },
    {
      'R',
      "Reset",
      cli_do_reset,
    },
    {
      '0',
      "*Digit",
      cli_digit,
    },
    {
      '1',
      "*Digit",
      cli_digit,
    },
    {
      '2',
      "*Digit",
      cli_digit,
    },
    {
      '3',
      "*Digit",
      cli_digit,
    },
    {
      '4',
      "*Digit",
      cli_digit,
    },
    {
      '5',
      "*Digit",
      cli_digit,
    },
    {
      '6',
      "*Digit",
      cli_digit,
    },
    {
      '7',
      "*Digit",
      cli_digit,
    },
    {
      '8',
      "*Digit",
      cli_digit,
    },
    {
      '9',
      "*Digit",
      cli_digit,
    },
    {
      '@',
      "Load app1",
      cli_load_app,
    },
    {
      'r',
      "Display VDU Regs",
      cli_display_vdu_regs,
    },
  };


////////////////////////////////////////////////////////////////////////////////
//
// Serial CLI Handling
//
////////////////////////////////////////////////////////////////////////////////

int pcount = 0;
int periodic_read = 0;

void serial_loop()
{
  int  key;
  
  if( ((key = getchar_timeout_us(1000)) != PICO_ERROR_TIMEOUT))
    {
      for(int i=0; i<sizeof(serial_cmds)/sizeof(SERIAL_COMMAND);i++)
	{
	  if( serial_cmds[i].key == key )
	    {
#if DEBUG_SERIAL
	      printf("\nKey:%d (0x%02X)", key, key);
#endif
	      keypress = key;
	      (*serial_cmds[i].fn)();
	      prompt();
	      break;
	    }
	}
    }
}

void serial_help(void)
{
  printf("\n");
  
  for(int i=0; i<sizeof(serial_cmds)/sizeof(SERIAL_COMMAND);i++)
    {
      if( *(serial_cmds[i].desc) != '*' )
	{
	  printf("\n%c:   %s", serial_cmds[i].key, serial_cmds[i].desc);
	}
    }
  printf("\n0-9: Enter parameter digit");
}


void prompt_breakpoint(void)
{
  printf("\n\n(Text Parameter:'%s'", text_parameter);
}

////////////////////////////////////////////////////////////////////////////////

//-----------------------------------------------------------------------------
//
// Put a value on the data bus

inline void set_data(BYTE data)
{
  int states;
  int dat = data & 0xff;
  
  // Direct register access to make things faster
  sio_hw->gpio_set = (  dat  << 0);
  sio_hw->gpio_clr = ((dat ^ 0xFF) << 0);
}


inline void set_data_inputs(void)
{
  sio_hw->gpio_oe_clr = 0x000000FF;
}

inline void set_data_outputs(void)
{
  sio_hw->gpio_oe_set = 0x000000FF;
}

////////////////////////////////////////////////////////////////////////////////
//
// Emulate memory
//
// Reads come from emulated memory unles out of range for emulation.
// Writes are always written to emulation memory, so all 64K has values.
//
//
////////////////////////////////////////////////////////////////////////////////

#define MSG_IN_CORE1 1

#define USB_FLAGS 1

void ram_emulate(void)
{
  
  irq_set_mask_enabled( 0xFFFFFFFF, false );

  while(1)
    {
      uint32_t gpio_states;
      uint32_t gpio_hi_states;
      
      BYTE db;
      unsigned int addr;
      
      gpio_states     = sio_hw->gpio_in;
      gpio_hi_states  = sio_hw->gpio_hi_in;
      
      if( ANY_CEOE_LOW )
        {
#if MSG_IN_CORE1
          printf("\nA CEOE is low");
          printf("\n%08X %08X", gpio_hi_states, gpio_states);
#endif
          // Read
          // data lines outputs
          set_data_outputs();
	  
          // ROM emulation so always a read of us
          // get address
          gpio_hi_states  = sio_hw->gpio_hi_in;
          addr = (gpio_hi_states) & ADDRESS_MASK;

          // The CEOE that is low determines which part of memory to present
          switch(MASK_ALL_CEOE & gpio_states)
            {
            case VAL_CEOE0_LOW:
              addr |= 2048*0;
              break;

            case VAL_CEOE1_LOW:
              addr |= 2048*1;
              break;

            case VAL_CEOE2_LOW:
              addr |= 2048*2;
              break;

            case VAL_CEOE3_LOW:
              addr |= 2048*3;
              break;
            }
          
          // Get data and present it on bus
          set_data(mem_data[addr]);

#if USB_FLAGS
          printf("       %04X:%02X", addr, mem_data[addr]);
#endif
          
          // Wait for RD and WR to be de-asserted
          while(1)
            {
              gpio_states = sio_hw->gpio_in;
              
#if MSG_IN_CORE1
              printf("\nWAIT %08X", gpio_states);
#endif
              // We look for CE
              if( !ANY_CEOE_LOW  )
                {
                  // CE high, we are not selected
                  // data lines inputs
                  set_data_inputs();
#if MSG_IN_CORE1
                  printf("\nDONE WAIT");
#endif
                  break;
                }
            }

#if TRACE_ON
          if( trace_running )
            {
              trace_addr[trace_i] = addr;
              trace_value[trace_i] = mem_data[addr];
              trace_type[trace_i++] = 'R';
              if( trace_i == TRACE_N )
                {
                  trace_running = 0;
                }
            }
#endif
        }
    }
}


////////////////////////////////////////////////////////////////////////////////
//
//    Core 1 
//
//
////////////////////////////////////////////////////////////////////////////////

////////////////////////////////////////////////////////////////////////////////
//
//
//


////////////////////////////////////////////////////////////////////////////////
//
// Core 1 handles the emulation of memory
//
//

#define TICK 0

uint32_t now = 0;
uint32_t last_time = 0;

void core1_main(void)
{
}

////////////////////////////////////////////////////////////////////////////////
//
//
////////////////////////////////////////////////////////////////////////////////


int main(void)
{
#if 0
  // Do nothing, GPIOs all inputs
  while(1)
    {
    }
#endif
  
  ////////////////////////////////////////////////////////////////////////////////
  // Set up GPIOs
  set_gpio_input(PIN_D0);
  set_gpio_input(PIN_D1);
  set_gpio_input(PIN_D2);
  set_gpio_input(PIN_D3);
  set_gpio_input(PIN_D4);
  set_gpio_input(PIN_D5);
  set_gpio_input(PIN_D6);
  set_gpio_input(PIN_D7);
  

  set_gpio_input(PIN_NRDS);
  set_gpio_input(PIN_SYNC);
  set_gpio_input(PIN_PHI2);
  set_gpio_input(PIN_CEOE0);
  set_gpio_input(PIN_CEOE1);
  set_gpio_input(PIN_CEOE2);
  set_gpio_input(PIN_CEOE3);

  // SD card GPIOs here
  set_gpio_input(PIN_K3);
  set_gpio_input(PIN_K2);
  set_gpio_input(PIN_K1);


  set_gpio_input(PIN_A0);
  set_gpio_input(PIN_A1);
  set_gpio_input(PIN_A2);
  set_gpio_input(PIN_A3);
  set_gpio_input(PIN_A4);
  set_gpio_input(PIN_A5);
  set_gpio_input(PIN_A6);
  set_gpio_input(PIN_A7);
  set_gpio_input(PIN_A8);
  set_gpio_input(PIN_A9);
  set_gpio_input(PIN_A10);
  set_gpio_input(PIN_A11);
  set_gpio_input(PIN_A12);
  set_gpio_input(PIN_A13);
  set_gpio_input(PIN_A14);
  set_gpio_input(PIN_A15);
  
  ////////////////////////////////////////////////////////////////////////////////
  //
  // Overclock as needed
  //
  ////////////////////////////////////////////////////////////////////////////////
  
  //#define OVERCLOCK 135000
  //#define OVERCLOCK 200000
#define OVERCLOCK 270000
  //#define OVERCLOCK 360000
  
#if OVERCLOCK > 270000
  /* Above this speed needs increased voltage */
  vreg_set_voltage(VREG_VOLTAGE_1_20);
  sleep_ms(1000);
#endif
  
  /* Overclock */
  set_sys_clock_khz( OVERCLOCK, 1 );

  //stdio_init_all();
  stdio_usb_init();

  // Run the shift register touch key scanning on the second core
  multicore_launch_core1(ram_emulate);

  //sleep_ms(3000);

  printf("\n");
  printf("\n                                  ********************************************");
  printf("\n                                  *        Acorn System 1 Gadget             *");
  printf("\n                                  ********************************************");
  printf("\n");
  printf("\nVersion:1.1.%d Compile time:%s %s", VERSION_INC, __DATE__, __TIME__);
  printf("\n");
  
#if OLED_ON
  // Set up OLED display
  i2c_init(&i2c_bus_0);
  
  oled_setup(&oled0);
#endif
  
  // Sets sd_ok flag for later use
#if SD_ON   

  printf("\nInitialising SD card driver...");

#define SD_CARD 1

  // Initialise SD card driver
  sd_init_driver();

  // Mount and unmount the SD card to set the sd_ok_flag up
  mount_sd();
  unmount_sd();
  
  oled_set_xy(&oled0, 0,21);
  if( sd_ok_flag )
    {
      oled_display_string(&oled0, "SD card OK");
      printf("\nSD card OK");
    }
  else
    {
      oled_display_string(&oled0, "SD card NOT OK");
      printf("\nSD card NOT OK");
    }

  mount_sd();
  if( !cd_to_dir(FILES_DIR) )
    {
      printf("\nFailed to cd to %s directory", FILES_DIR);
      printf("\n%s", sd_error);
    }
  else
    {
      printf("\n%s directory found", FILES_DIR);
    }
  unmount_sd();

  sleep_ms(1000);
#endif

#if OLED_ON
  // Overall loop, which contains the polling loop and the menu loop
  oled_clear_display(&oled0);
  
  oled_set_xy(&oled0, 5, 0);
  oled_display_string(&oled0, "Acorn System 1");

  oled_set_xy(&oled0, 5, 16);
  oled_display_string(&oled0, "Memory Emulator");

#endif

  // Run the shift register touch key scanning on the second core
  //  multicore_launch_core1(core1_main);

  //------------------------------------------------------------------------------
  
  // Set up the OLED menu
  
  current_menu = (struct MENU_ELEMENT *) &(home_menu[0]);
  last_menu    = (struct MENU_ELEMENT *) &(home_menu[0]);
  the_home_menu = last_menu;

  //to_home_menu(NULL);

  //  init_buttons();

  //------------------------------------------------------------------------------
  // Load the monitor
  
  cli_load_monitor();
  
  //------------------------------------------------------------------------------
  
  while(1)
    {
#if DEBUG_LOOP
      printf("\nLoop");
#endif
      
      serial_loop();

    }
}



volatile uint8_t mem_data1[MEM_SIZE] = {
  0x00, 0x8e, 0x00, 0x98, 0x00, 0xe5, 0x00, 0xe9, 0x00, 0xf9, 0x00, 0xfc, 0x00, 0xfc, 0x01, 0x07,
  0x04, 0x32, 0x07, 0xa4, 0x07, 0xa4, 0x07, 0xa4, 0x07, 0xa4, 0x07, 0xa4, 0x07, 0xa4, 0x01, 0x21,
  0x01, 0x21, 0x01, 0x0d, 0x01, 0x21, 0x01, 0x8b, 0x01, 0xd0, 0x01, 0xd6, 0x04, 0x32, 0x02, 0x10,
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  0x83, 0x71, 0x67, 0x3b, 0x92, 0x80, 0x83, 0x71, 0x67, 0x92, 0x88, 0x83, 0x71, 0x67, 0x29, 0x45,
};


volatile uint8_t mem_data2[MEM_SIZE] = {
  0x00, 0x8E, 0x00, 0x98, 0x00, 0xE5, 0x00, 0xE9, 0x00, 0xF9, 0x00, 0xFC,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 0x79,
  0x0A, 0xBE, 0x08, 0xD2, 0x08, 0x59, 0x0E, 0xB7, 0x04, 0x32, 0x04, 0xBC,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 0x54,
  0x03, 0x2A, 0x07, 0x69, 0x0A, 0x6E, 0x08, 0xD5, 0x0B, 0x3E, 0x0D, 0x8E,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 0x8A,
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  0x28, 0xFE, 0x3D, 0x3A, 0xC2, 0x4C, 0x29, 0x80, 0x87, 0x73, 0x84, 0x73,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 0x87,

};
  

volatile uint8_t mem_data[MEM_SIZE] = {
  0x00, 0x8E, 0x00, 0x98, 0x00, 0xE5, 0x00, 0xE9, 0x00, 0xF9, 0x00, 0xFC, 0x00, 0xFC, 0x01, 0x07,
  0x04, 0x32, 0x07, 0xA4, 0x07, 0xA4, 0x07, 0xA4, 0x07, 0xA4, 0x07, 0xA4, 0x07, 0xA4, 0x01, 0x21,
  0x01, 0x21, 0x01, 0x0D, 0x01, 0x21, 0x01, 0x8B, 0x01, 0xD0, 0x01, 0xD6, 0x04, 0x32, 0x02, 0x10,
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  0x00, 0x00, 0x00, 0x00, 0x00, 0x00, 0x00, 0x00, 0x00, 0x00, 0x00, 0x00, 0x00, 0x00, 0x00, 0x00,


                                                                                                                                                                                                                                };
